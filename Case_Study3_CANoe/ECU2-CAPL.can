/*@!Encoding:65001*/














variables
{
  
  int var_speed=0;
  
  
  message Speed_val_Massage m_speed;
}





on start
{
    write ("eslam ahmed"); 

  
  
}




on message ACC_CMD_Message
{
  if (this.ACC_On.phys==1)
  {
      if(var_speed==255)
      
        var_speed=255;
        else
        var_speed++;
      

  }
  
   else
  {
      if(var_speed==0)
      
        var_speed=0;
        else
        var_speed--;
      

  }
  
  m_speed.Speed=var_speed;
  output(m_speed);
 
}
