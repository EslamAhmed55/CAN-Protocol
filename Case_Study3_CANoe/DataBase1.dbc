VERSION ""

NS_ :

BS_:

BU_: ECU2_Speed_Sensor ECU1_ACC_CMD

BO_ 939 Speed_val_Massage: 1 ECU2_Speed_Sensor
 SG_ Speed : 0|8@1+ (255,0) [0|0] ""  ECU1_ACC_CMD

BO_ 48 ACC_CMD_Message: 1 ECU1_ACC_CMD
 SG_ ACC_On : 0|8@1+ (1,0) [0|0] ""  ECU2_Speed_Sensor
