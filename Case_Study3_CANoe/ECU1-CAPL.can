/*@!Encoding:65001*/
includes
{
  
}

variables
{
  msTimer send_time;
  const int timer_period=1000;
  message ACC_CMD_Message ACC_CMD;
  int variable_ACC =0;
}

on start
{
    write ("Eslam Ahmed"); 

  setTimer(send_time,timer_period);
  
  
}

on message Speed_val_Massage
{
  write ("ECU1 Recieved From ECU2"); 
}

on timer send_time
{
      write ("Eslam Ahmed"); 
  variable_ACC = @sysvar::ACC_System_VAL;
 ACC_CMD.ACC_On.phys=variable_ACC;
output(ACC_CMD);
    setTimer(send_time,timer_period);
  

}

